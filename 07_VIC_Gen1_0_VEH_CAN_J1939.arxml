[part 2 of 2: packages /Vehicle_CAN_Bus_J1939/DataTypes to /Vehicle_CAN_Bus_J1939/ECUs]
AUTOSAR XML (schema 4-1-3)
package /Vehicle_CAN_Bus_J1939/DataTypes
  base type Amb_AirT_Coding: category=FIXED_LENGTH, base-type-size=16, base-type-encoding=NONE, mem-alignment=0, native-declaration=unsigned short
  unit Amb_AirT_Unit: display-name=°C
  base type Awl_Coding: category=FIXED_LENGTH, base-type-size=8, base-type-encoding=NONE, mem-alignment=0, native-declaration=unsigned char
  base type Balancing_Active_Coding: category=FIXED_LENGTH, base-type-size=8, base-type-encoding=NONE, mem-alignment=0, native-declaration=unsigned char
  unit Balancing_Active_Unit: display-name=bit
  base type Barometric_P_Coding: category=FIXED_LENGTH, base-type-size=8, base-type-encoding=NONE, mem-alignment=0, native-declaration=unsigned char
  unit Barometric_P_Unit: display-name=kPa
  base type Brake_Switch_Coding: category=FIXED_LENGTH, base-type-size=8, base-type-encoding=NONE, mem-alignment=0, native-declaration=unsigned char
  unit Brake_Switch_Unit: display-name=bit
  base type CRC_PGN61427_Coding: category=FIXED_LENGTH, base-type-size=8, base-type-encoding=NONE, mem-alignment=0, native-declaration=unsigned char
  unit CRC_PGN61427_Unit: display-name=unit
  base type Cab_InteriorT_Coding: category=FIXED_LENGTH, base-type-size=16, base-type-encoding=NONE, mem-alignment=0, native-declaration=unsigned short
  unit Cab_InteriorT_Unit: display-name=°C
  base type CellTPermsnToCls_Coding: category=FIXED_LENGTH, base-type-size=8, base-type-encoding=NONE, mem-alignment=0, native-declaration=unsigned char
  base type CellUPermsnToCls_Coding: category=FIXED_LENGTH, base-type-size=8, base-type-encoding=NONE, mem-alignment=0, native-declaration=unsigned char
  base type Clutch_Switch_Coding: category=FIXED_LENGTH, base-type-size=8, base-type-encoding=NONE, mem-alignment=0, native-declaration=unsigned char
  unit Clutch_Switch_Unit: display-name=bit
  base type Control_Byte_TP_CM_Coding: category=FIXED_LENGTH, base-type-size=8, base-type-encoding=NONE, mem-alignment=0, native-declaration=unsigned char
  unit Control_Byte_TP_CM_Unit: display-name=bit
  base type Control_Es_Relay_Coding: category=FIXED_LENGTH, base-type-size=8, base-type-encoding=NONE, mem-alignment=0, native-declaration=unsigned char
  unit Control_Es_Relay_Unit: display-name=bit
  base type Counter_PGN61427_Coding: category=FIXED_LENGTH, base-type-size=8, base-type-encoding=NONE, mem-alignment=0, native-declaration=unsigned char
  unit Counter_PGN61427_Unit: display-name=unit
  base type CptTPermsnToCls_Coding: category=FIXED_LENGTH, base-type-size=8, base-type-encoding=NONE, mem-alignment=0, native-declaration=unsigned char
  base type CrashPermsnToCls_Coding: category=FIXED_LENGTH, base-type-size=8, base-type-encoding=NONE, mem-alignment=0, native-declaration=unsigned char
  base type Crash_Cks_Coding: category=FIXED_LENGTH, base-type-size=8, base-type-encoding=NONE, mem-alignment=0, native-declaration=unsigned char
  unit Crash_Cks_Unit: display-name=count
  base type Crash_Ctr_Coding: category=FIXED_LENGTH, base-type-size=8, base-type-encoding=NONE, mem-alignment=0, native-declaration=unsigned char
  unit Crash_Ctr_Unit: display-name=count
  base type Crash_Typ_Coding: category=FIXED_LENGTH, base-type-size=8, base-type-encoding=NONE, mem-alignment=0, native-declaration=unsigned char
  unit Crash_Typ_Unit: display-name=bit-mapped
  base type Cruise_Control_Accelerate_Swtch_Coding: category=FIXED_LENGTH, base-type-size=8, base-type-encoding=NONE, mem-alignment=0, native-declaration=unsigned char
  unit Cruise_Control_Accelerate_Swtch_Unit: display-name=bit
  base type Cruise_Control_Active_Coding: category=FIXED_LENGTH, base-type-size=8, base-type-encoding=NONE, mem-alignment=0, native-declaration=unsigned char
  unit Cruise_Control_Active_Unit: display-name=bit
  base type Cruise_Control_Coast_Decl_Switch_Coding: category=FIXED_LENGTH, base-type-size=8, base-type-encoding=NONE, mem-alignment=0, native-declaration=unsigned char
  unit Cruise_Control_Coast_Decl_Switch_Unit: display-name=bit
  base type Cruise_Control_Enable_Swtch_Coding: category=FIXED_LENGTH, base-type-size=8, base-type-encoding=NONE, mem-alignment=0, native-declaration=unsigned char
  unit Cruise_Control_Enable_Swtch_Unit: display-name=bit
  base type Cruise_Control_Pause_Swtch_Coding: category=FIXED_LENGTH, base-type-size=8, base-type-encoding=NONE, mem-alignment=0, native-declaration=unsigned char
  unit Cruise_Control_Pause_Swtch_Unit: display-name=bit
  base type Cruise_Control_Resume_Swtch_Coding: category=FIXED_LENGTH, base-type-size=8, base-type-encoding=NONE, mem-alignment=0, native-declaration=unsigned char
  unit Cruise_Control_Resume_Swtch_Unit: display-name=bit
  base type Cruise_Control_SetSwtch_Coding: category=FIXED_LENGTH, base-type-size=8, base-type-encoding=NONE, mem-alignment=0, native-declaration=unsigned char
  unit Cruise_Control_SetSwtch_Unit: display-name=bit
  base type Cruise_Control_Set_Spd_Coding: category=FIXED_LENGTH, base-type-size=8, base-type-encoding=NONE, mem-alignment=0, native-declaration=unsigned char
  unit Cruise_Control_Set_Spd_Unit: display-name=km/h
  base type Cruise_Control_States_Coding: category=FIXED_LENGTH, base-type-size=8, base-type-encoding=NONE, mem-alignment=0, native-declaration=unsigned char
  unit Cruise_Control_States_Unit: display-name=bit
  base type CtctrStuckPermsnToCls_Coding: category=FIXED_LENGTH, base-type-size=8, base-type-encoding=NONE, mem-alignment=0, native-declaration=unsigned char
  base type Current_Actual_Coding: category=FIXED_LENGTH, base-type-size=16, base-type-encoding=NONE, mem-alignment=0, native-declaration=unsigned short
  unit Current_Actual_Unit: display-name=A
  base type Current_Charging_Max_Actual_Coding: category=FIXED_LENGTH, base-type-size=16, base-type-encoding=NONE, mem-alignment=0, native-declaration=unsigned short
  unit Current_Charging_Max_Actual_Unit: display-name=A
  base type Current_Discharging_Max_Actual_Coding: category=FIXED_LENGTH, base-type-size=16, base-type-encoding=NONE, mem-alignment=0, native-declaration=unsigned short
  unit Current_Discharging_Max_Actual_Unit: display-name=A
  base type Day_Coding: category=FIXED_LENGTH, base-type-size=8, base-type-encoding=NONE, mem-alignment=0, native-declaration=unsigned char
  unit Day_Unit: display-name=days
  base type DcChCtctrPermsnToCls_Coding: category=FIXED_LENGTH, base-type-size=8, base-type-encoding=NONE, mem-alignment=0, native-declaration=unsigned char
  base type EnaCoolgHeatgBatFlag_Coding: category=FIXED_LENGTH, base-type-size=8, base-type-encoding=NONE, mem-alignment=0, native-declaration=unsigned char
  base type Eng_Intk1AirT_Coding: category=FIXED_LENGTH, base-type-size=8, base-type-encoding=NONE, mem-alignment=0, native-declaration=unsigned char
  unit Eng_Intk1AirT_Unit: display-name=°C
  base type Engine_Diag_Test_Mode_Swtch_Coding: category=FIXED_LENGTH, base-type-size=8, base-type-encoding=NONE, mem-alignment=0, native-declaration=unsigned char
  unit Engine_Diag_Test_Mode_Swtch_Unit: display-name=bit
  base type Engine_Idle_Decrement_Switch_Coding: category=FIXED_LENGTH, base-type-size=8, base-type-encoding=NONE, mem-alignment=0, native-declaration=unsigned char
  unit Engine_Idle_Decrement_Switch_Unit: display-name=bit
  base type Engine_Idle_Increment_Switch_Coding: category=FIXED_LENGTH, base-type-size=8, base-type-encoding=NONE, mem-alignment=0, native-declaration=unsigned char
  unit Engine_Idle_Increment_Switch_Unit: display-name=bit
  base type Engine_Shutdwn_Ovride_Swtch_Coding: category=FIXED_LENGTH, base-type-size=8, base-type-encoding=NONE, mem-alignment=0, native-declaration=unsigned char
  unit Engine_Shutdwn_Ovride_Swtch_Unit: display-name=bit
  base type ErrLvl_Coding: category=FIXED_LENGTH, base-type-size=8, base-type-encoding=NONE, mem-alignment=0, native-declaration=unsigned char
  unit ErrLvl_Unit: display-name=unit
  base type Flash_Awl_Coding: category=FIXED_LENGTH, base-type-size=8, base-type-encoding=NONE, mem-alignment=0, native-declaration=unsigned char
  base type Flash_Mil_Coding: category=FIXED_LENGTH, base-type-size=8, base-type-encoding=NONE, mem-alignment=0, native-declaration=unsigned char
  base type Flash_ProtLamp_Coding: category=FIXED_LENGTH, base-type-size=8, base-type-encoding=NONE, mem-alignment=0, native-declaration=unsigned char
  base type Flash_Rsl_Coding: category=FIXED_LENGTH, base-type-size=8, base-type-encoding=NONE, mem-alignment=0, native-declaration=unsigned char
  base type Fmi01_Coding: category=FIXED_LENGTH, base-type-size=8, base-type-encoding=NONE, mem-alignment=0, native-declaration=unsigned char
  unit Fmi01_Unit: display-name=binary
  base type Fmi02_Coding: category=FIXED_LENGTH, base-type-size=8, base-type-encoding=NONE, mem-alignment=0, native-declaration=unsigned char
  unit Fmi02_Unit: display-name=binary
  base type Fmi03_Coding: category=FIXED_LENGTH, base-type-size=8, base-type-encoding=NONE, mem-alignment=0, native-declaration=unsigned char
  unit Fmi03_Unit: display-name=binary
  base type Fmi04_Coding: category=FIXED_LENGTH, base-type-size=8, base-type-encoding=NONE, mem-alignment=0, native-declaration=unsigned char
  unit Fmi04_Unit: display-name=binary
  base type Fmi05_Coding: category=FIXED_LENGTH, base-type-size=8, base-type-encoding=NONE, mem-alignment=0, native-declaration=unsigned char
  unit Fmi05_Unit: display-name=binary
  base type Fmi06_Coding: category=FIXED_LENGTH, base-type-size=8, base-type-encoding=NONE, mem-alignment=0, native-declaration=unsigned char
  unit Fmi06_Unit: display-name=binary
  base type Fmi07_Coding: category=FIXED_LENGTH, base-type-size=8, base-type-encoding=NONE, mem-alignment=0, native-declaration=unsigned char
  unit Fmi07_Unit: display-name=binary
  base type Fmi08_Coding: category=FIXED_LENGTH, base-type-size=8, base-type-encoding=NONE, mem-alignment=0, native-declaration=unsigned char
  unit Fmi08_Unit: display-name=binary
  base type Fmi09_Coding: category=FIXED_LENGTH, base-type-size=8, base-type-encoding=NONE, mem-alignment=0, native-declaration=unsigned char
  unit Fmi09_Unit: display-name=binary
  base type Fmi10_Coding: category=FIXED_LENGTH, base-type-size=8, base-type-encoding=NONE, mem-alignment=0, native-declaration=unsigned char
  unit Fmi10_Unit: display-name=binary
  base type HS_AvgCellTemp_Coding: category=FIXED_LENGTH, base-type-size=16, base-type-encoding=NONE, mem-alignment=0, native-declaration=unsigned short
  unit HS_AvgCellTemp_Unit: display-name=°C
  base type HS_AvlChPwr_Coding: category=FIXED_LENGTH, base-type-size=16, base-type-encoding=NONE, mem-alignment=0, native-declaration=unsigned short
  unit HS_AvlChPwr_Unit: display-name=kW
  base type HS_AvlDchaPwr_Coding: category=FIXED_LENGTH, base-type-size=16, base-type-encoding=NONE, mem-alignment=0, native-declaration=unsigned short
  unit HS_AvlDchaPwr_Unit: display-name=kW
  base type HS_CellBalSts_Coding: category=FIXED_LENGTH, base-type-size=8, base-type-encoding=NONE, mem-alignment=0, native-declaration=unsigned char
  unit HS_CellBalSts_Unit: display-name=bit
  base type HS_CellBalnAcv_Coding: category=FIXED_LENGTH, base-type-size=8, base-type-encoding=NONE, mem-alignment=0, native-declaration=unsigned char
  unit HS_CellBalnAcv_Unit: display-name=bit
  base type HS_CellBalnCmd_Rx1_Coding: category=FIXED_LENGTH, base-type-size=8, base-type-encoding=NONE, mem-alignment=0, native-declaration=unsigned char
  unit HS_CellBalnCmd_Rx1_Unit: display-name=bit
  base type HS_CellBalnCmd_Rx2_Coding: category=FIXED_LENGTH, base-type-size=8, base-type-encoding=NONE, mem-alignment=0, native-declaration=unsigned char
  unit HS_CellBalnCmd_Rx2_Unit: display-name=bit
  base type HS_CellBalnCmd_Tx_Coding: category=FIXED_LENGTH, base-type-size=8, base-type-encoding=NONE, mem-alignment=0, native-declaration=unsigned char
  unit HS_CellBalnCmd_Tx_Unit: display-name=bit
  base type HS_CellTempDiffStatus_Coding: category=FIXED_LENGTH, base-type-size=8, base-type-encoding=NONE, mem-alignment=0, native-declaration=unsigned char
  unit HS_CellTempDiffStatus_Unit: display-name=bit
  base type HS_CellVoltDiffStatus_Coding: category=FIXED_LENGTH, base-type-size=8, base-type-encoding=NONE, mem-alignment=0, native-declaration=unsigned char
  base type HS_CentrofPackCtctrSt_Coding: category=FIXED_LENGTH, base-type-size=8, base-type-encoding=NONE, mem-alignment=0, native-declaration=unsigned char
  unit HS_CentrofPackCtctrSt_Unit: display-name=bit
  base type HS_ChEC_Coding: category=FIXED_LENGTH, base-type-size=32, base-type-encoding=NONE, mem-alignment=0, native-declaration=unsigned long
  unit HS_ChEC_Unit: display-name=kWh
  base type HS_ChILim_Coding: category=FIXED_LENGTH, base-type-size=16, base-type-encoding=NONE, mem-alignment=0, native-declaration=unsigned short
  unit HS_ChILim_Unit: display-name=A
  base type HS_CtctrOpenUnderLoaCt_Coding: category=FIXED_LENGTH, base-type-size=16, base-type-encoding=NONE, mem-alignment=0, native-declaration=unsigned short
  unit HS_CtctrOpenUnderLoaCt_Unit: display-name=count
  base type HS_Ctl1CRC_Rx1_Coding: category=FIXED_LENGTH, base-type-size=8, base-type-encoding=NONE, mem-alignment=0, native-declaration=unsigned char
  unit HS_Ctl1CRC_Rx1_Unit: display-name=count
  base type HS_Ctl1CRC_Rx2_Coding: category=FIXED_LENGTH, base-type-size=8, base-type-encoding=NONE, mem-alignment=0, native-declaration=unsigned char
  unit HS_Ctl1CRC_Rx2_Unit: display-name=count
  base type HS_Ctl1CRC_Tx_Coding: category=FIXED_LENGTH, base-type-size=8, base-type-encoding=NONE, mem-alignment=0, native-declaration=unsigned char
  unit HS_Ctl1CRC_Tx_Unit: display-name=count
  base type HS_Ctl1Ctr_Rx1_Coding: category=FIXED_LENGTH, base-type-size=8, base-type-encoding=NONE, mem-alignment=0, native-declaration=unsigned char
  unit HS_Ctl1Ctr_Rx1_Unit: display-name=bit
  base type HS_Ctl1Ctr_Rx2_Coding: category=FIXED_LENGTH, base-type-size=8, base-type-encoding=NONE, mem-alignment=0, native-declaration=unsigned char
  unit HS_Ctl1Ctr_Rx2_Unit: display-name=bit
  base type HS_Ctl1Ctr_Tx_Coding: category=FIXED_LENGTH, base-type-size=8, base-type-encoding=NONE, mem-alignment=0, native-declaration=unsigned char
  unit HS_Ctl1Ctr_Tx_Unit: display-name=bit
  base type HS_DchaEC_Coding: category=FIXED_LENGTH, base-type-size=32, base-type-encoding=NONE, mem-alignment=0, native-declaration=unsigned long
  unit HS_DchaEC_Unit: display-name=kWh
  base type HS_DchaILim_Coding: category=FIXED_LENGTH, base-type-size=16, base-type-encoding=NONE, mem-alignment=0, native-declaration=unsigned short
  unit HS_DchaILim_Unit: display-name=A
  base type HS_EnaIntChrgrCmd_Rx1_Coding: category=FIXED_LENGTH, base-type-size=8, base-type-encoding=NONE, mem-alignment=0, native-declaration=unsigned char
  unit HS_EnaIntChrgrCmd_Rx1_Unit: display-name=bit
  base type HS_EnaIntChrgrCmd_Rx2_Coding: category=FIXED_LENGTH, base-type-size=8, base-type-encoding=NONE, mem-alignment=0, native-declaration=unsigned char
  unit HS_EnaIntChrgrCmd_Rx2_Unit: display-name=bit
  base type HS_EnaIntChrgrCmd_Tx_Coding: category=FIXED_LENGTH, base-type-size=8, base-type-encoding=NONE, mem-alignment=0, native-declaration=unsigned char
  unit HS_EnaIntChrgrCmd_Tx_Unit: display-name=bit
  base type HS_FastUpdSOC_Coding: category=FIXED_LENGTH, base-type-size=16, base-type-encoding=NONE, mem-alignment=0, native-declaration=unsigned short
  unit HS_FastUpdSOC_Unit: display-name=%
  base type HS_HVILSts_Coding: category=FIXED_LENGTH, base-type-size=8, base-type-encoding=NONE, mem-alignment=0, native-declaration=unsigned char
  unit HS_HVILSts_Unit: display-name=bit
  base type HS_HiCellSOCCellNum_Coding: category=FIXED_LENGTH, base-type-size=8, base-type-encoding=NONE, mem-alignment=0, native-declaration=unsigned char
  unit HS_HiCellSOCCellNum_Unit: display-name=count
  base type HS_HiCellSOCMNum_Coding: category=FIXED_LENGTH, base-type-size=8, base-type-encoding=NONE, mem-alignment=0, native-declaration=unsigned char
  unit HS_HiCellSOCMNum_Unit: display-name=count
  base type HS_HiCellTemp_Coding: category=FIXED_LENGTH, base-type-size=16, base-type-encoding=NONE, mem-alignment=0, native-declaration=unsigned short
  unit HS_HiCellTemp_Unit: display-name=°C
  base type HS_HiCellVolt_Coding: category=FIXED_LENGTH, base-type-size=16, base-type-encoding=NONE, mem-alignment=0, native-declaration=unsigned short
  unit HS_HiCellVolt_Unit: display-name=V
  base type HS_HiUBusAcvIslnTestCmd_Rx1_Coding: category=FIXED_LENGTH, base-type-size=8, base-type-encoding=NONE, mem-alignment=0, native-declaration=unsigned char
  unit HS_HiUBusAcvIslnTestCmd_Rx1_Unit: display-name=bit
  base type HS_HiUBusAcvIslnTestCmd_Rx2_Coding: category=FIXED_LENGTH, base-type-size=8, base-type-encoding=NONE, mem-alignment=0, native-declaration=unsigned char
  unit HS_HiUBusAcvIslnTestCmd_Rx2_Unit: display-name=bit
  base type HS_HiUBusAcvIslnTestCmd_Tx_Coding: category=FIXED_LENGTH, base-type-size=8, base-type-encoding=NONE, mem-alignment=0, native-declaration=unsigned char
  unit HS_HiUBusAcvIslnTestCmd_Tx_Unit: display-name=bit
  base type HS_HiUBusAcvIslnTestSts_Coding: category=FIXED_LENGTH, base-type-size=8, base-type-encoding=NONE, mem-alignment=0, native-declaration=unsigned char
  unit HS_HiUBusAcvIslnTestSts_Unit: display-name=bit
  base type HS_HiUBusCnctCmd_Rx1_Coding: category=FIXED_LENGTH, base-type-size=8, base-type-encoding=NONE, mem-alignment=0, native-declaration=unsigned char
  unit HS_HiUBusCnctCmd_Rx1_Unit: display-name=bit
  base type HS_HiUBusCnctCmd_Rx2_Coding: category=FIXED_LENGTH, base-type-size=8, base-type-encoding=NONE, mem-alignment=0, native-declaration=unsigned char
  unit HS_HiUBusCnctCmd_Rx2_Unit: display-name=bit
  base type HS_HiUBusCnctCmd_Tx_Coding: category=FIXED_LENGTH, base-type-size=8, base-type-encoding=NONE, mem-alignment=0, native-declaration=unsigned char
  unit HS_HiUBusCnctCmd_Tx_Unit: display-name=bit
  base type HS_HiUBusCnctnSts_Coding: category=FIXED_LENGTH, base-type-size=8, base-type-encoding=NONE, mem-alignment=0, native-declaration=unsigned char
  unit HS_HiUBusCnctnSts_Unit: display-name=bit
  base type HS_HiUBusDcnctForewarning_Coding: category=FIXED_LENGTH, base-type-size=8, base-type-encoding=NONE, mem-alignment=0, native-declaration=unsigned char
  unit HS_HiUBusDcnctForewarning_Unit: display-name=bit
  base type HS_HiUBusHiSideRestrCnctReq_Rx1_Coding: category=FIXED_LENGTH, base-type-size=8, base-type-encoding=NONE, mem-alignment=0, native-declaration=unsigned char
  unit HS_HiUBusHiSideRestrCnctReq_Rx1_Unit: display-name=bit
  base type HS_HiUBusHiSideRestrCnctReq_Rx2_Coding: category=FIXED_LENGTH, base-type-size=8, base-type-encoding=NONE, mem-alignment=0, native-declaration=unsigned char
  unit HS_HiUBusHiSideRestrCnctReq_Rx2_Unit: display-name=bit
  base type HS_HiUBusHiSideRestrCnctReq_Tx_Coding: category=FIXED_LENGTH, base-type-size=8, base-type-encoding=NONE, mem-alignment=0, native-declaration=unsigned char
  unit HS_HiUBusHiSideRestrCnctReq_Tx_Unit: display-name=bit
  base type HS_HiUBusLoSideRestrCnctReq_Rx1_Coding: category=FIXED_LENGTH, base-type-size=8, base-type-encoding=NONE, mem-alignment=0, native-declaration=unsigned char
  unit HS_HiUBusLoSideRestrCnctReq_Rx1_Unit: display-name=bit
  base type HS_HiUBusLoSideRestrCnctReq_Rx2_Coding: category=FIXED_LENGTH, base-type-size=8, base-type-encoding=NONE, mem-alignment=0, native-declaration=unsigned char
  unit HS_HiUBusLoSideRestrCnctReq_Rx2_Unit: display-name=bit
  base type HS_HiUBusLoSideRestrCnctReq_Tx_Coding: category=FIXED_LENGTH, base-type-size=8, base-type-encoding=NONE, mem-alignment=0, native-declaration=unsigned char
  unit HS_HiUBusLoSideRestrCnctReq_Tx_Unit: display-name=bit
  base type HS_HiUBusNegCtctrSt_Coding: category=FIXED_LENGTH, base-type-size=8, base-type-encoding=NONE, mem-alignment=0, native-declaration=unsigned char
  unit HS_HiUBusNegCtctrSt_Unit: display-name=bit
  base type HS_HiUBusPasIslnTestCmd_Rx1_Coding: category=FIXED_LENGTH, base-type-size=8, base-type-encoding=NONE, mem-alignment=0, native-declaration=unsigned char
  unit HS_HiUBusPasIslnTestCmd_Rx1_Unit: display-name=bit
  base type HS_HiUBusPasIslnTestCmd_Rx2_Coding: category=FIXED_LENGTH, base-type-size=8, base-type-encoding=NONE, mem-alignment=0, native-declaration=unsigned char
  unit HS_HiUBusPasIslnTestCmd_Rx2_Unit: display-name=bit
  base type HS_HiUBusPasIslnTestCmd_Tx_Coding: category=FIXED_LENGTH, base-type-size=8, base-type-encoding=NONE, mem-alignment=0, native-declaration=unsigned char
  unit HS_HiUBusPasIslnTestCmd_Tx_Unit: display-name=bit
  base type HS_HiUBusPasIslnTestSts_Coding: category=FIXED_LENGTH, base-type-size=8, base-type-encoding=NONE, mem-alignment=0, native-declaration=unsigned char
  unit HS_HiUBusPasIslnTestSts_Unit: display-name=bit
  base type HS_HiUBusPosCtctrSt_Coding: category=FIXED_LENGTH, base-type-size=8, base-type-encoding=NONE, mem-alignment=0, native-declaration=unsigned char
  unit HS_HiUBusPosCtctrSt_Unit: display-name=bit
  base type HS_HiUBusPreChRlySt_Coding: category=FIXED_LENGTH, base-type-size=8, base-type-encoding=NONE, mem-alignment=0, native-declaration=unsigned char
  unit HS_HiUBusPreChRlySt_Unit: display-name=bit
  base type HS_HiVoltBusActIslTR_Coding: category=FIXED_LENGTH, base-type-size=16, base-type-encoding=NONE, mem-alignment=0, native-declaration=unsigned short
  unit HS_HiVoltBusActIslTR_Unit: display-name=ohm/V
  base type HS_HiVoltBusPasIslTR_Coding: category=FIXED_LENGTH, base-type-size=16, base-type-encoding=NONE, mem-alignment=0, native-declaration=unsigned short
  unit HS_HiVoltBusPasIslTR_Unit: display-name=ohm/V
  base type HS_I_Coding: category=FIXED_LENGTH, base-type-size=16, base-type-encoding=NONE, mem-alignment=0, native-declaration=unsigned short
  unit HS_I_Unit: display-name=A
  base type HS_IntChrgrSts_Coding: category=FIXED_LENGTH, base-type-size=8, base-type-encoding=NONE, mem-alignment=0, native-declaration=unsigned char
  unit HS_IntChrgrSts_Unit: display-name=bit
  base type HS_JSwtSts_Coding: category=FIXED_LENGTH, base-type-size=8, base-type-encoding=NONE, mem-alignment=0, native-declaration=unsigned char
  unit HS_JSwtSts_Unit: display-name=bit
  base type HS_LowCellSOCCellNum_Coding: category=FIXED_LENGTH, base-type-size=8, base-type-encoding=NONE, mem-alignment=0, native-declaration=unsigned char
  unit HS_LowCellSOCCellNum_Unit: display-name=count
  base type HS_LowCellSOCMNum_Coding: category=FIXED_LENGTH, base-type-size=8, base-type-encoding=NONE, mem-alignment=0, native-declaration=unsigned char
  unit HS_LowCellSOCMNum_Unit: display-name=count
  base type HS_LowCellTemp_Coding: category=FIXED_LENGTH, base-type-size=16, base-type-encoding=NONE, mem-alignment=0, native-declaration=unsigned short
  unit HS_LowCellTemp_Unit: display-name=°C
  base type HS_LowCellVolt_Coding: category=FIXED_LENGTH, base-type-size=16, base-type-encoding=NONE, mem-alignment=0, native-declaration=unsigned short
  unit HS_LowCellVolt_Unit: display-name=V
  base type HS_MaxCellStofCh_Coding: category=FIXED_LENGTH, base-type-size=16, base-type-encoding=NONE, mem-alignment=0, native-declaration=unsigned short
  unit HS_MaxCellStofCh_Unit: display-name=%
  base type HS_MaxChULim_Coding: category=FIXED_LENGTH, base-type-size=16, base-type-encoding=NONE, mem-alignment=0, native-declaration=unsigned short
  unit HS_MaxChULim_Unit: display-name=V
  base type HS_MinCellStofCh_Coding: category=FIXED_LENGTH, base-type-size=16, base-type-encoding=NONE, mem-alignment=0, native-declaration=unsigned short
  unit HS_MinCellStofCh_Unit: display-name=%
  base type HS_NrofHPsRdy_Coding: category=FIXED_LENGTH, base-type-size=8, base-type-encoding=NONE, mem-alignment=0, native-declaration=unsigned char
  unit HS_NrofHPsRdy_Unit: display-name=count
  base type HS_OperConsent_Rx1_Coding: category=FIXED_LENGTH, base-type-size=8, base-type-encoding=NONE, mem-alignment=0, native-declaration=unsigned char
  unit HS_OperConsent_Rx1_Unit: display-name=bit
  base type HS_OperConsent_Rx2_Coding: category=FIXED_LENGTH, base-type-size=8, base-type-encoding=NONE, mem-alignment=0, native-declaration=unsigned char
  unit HS_OperConsent_Rx2_Unit: display-name=bit
  base type HS_OperConsent_Tx_Coding: category=FIXED_LENGTH, base-type-size=8, base-type-encoding=NONE, mem-alignment=0, native-declaration=unsigned char
  unit HS_OperConsent_Tx_Unit: display-name=bit
  base type HS_OperationalSts_Coding: category=FIXED_LENGTH, base-type-size=8, base-type-encoding=NONE, mem-alignment=0, native-declaration=unsigned char
  unit HS_OperationalSts_Unit: display-name=bit
  base type HS_PwrDwnCmd_Rx1_Coding: category=FIXED_LENGTH, base-type-size=8, base-type-encoding=NONE, mem-alignment=0, native-declaration=unsigned char
  unit HS_PwrDwnCmd_Rx1_Unit: display-name=bit
  base type HS_PwrDwnCmd_Rx2_Coding: category=FIXED_LENGTH, base-type-size=8, base-type-encoding=NONE, mem-alignment=0, native-declaration=unsigned char
  unit HS_PwrDwnCmd_Rx2_Unit: display-name=bit
  base type HS_PwrDwnCmd_Tx_Coding: category=FIXED_LENGTH, base-type-size=8, base-type-encoding=NONE, mem-alignment=0, native-declaration=unsigned char
  unit HS_PwrDwnCmd_Tx_Unit: display-name=bit
  base type HS_StofChSts_Coding: category=FIXED_LENGTH, base-type-size=8, base-type-encoding=NONE, mem-alignment=0, native-declaration=unsigned char
  unit HS_StofChSts_Unit: display-name=bit
  base type HS_StofHealth_Coding: category=FIXED_LENGTH, base-type-size=8, base-type-encoding=NONE, mem-alignment=0, native-declaration=unsigned char
  unit HS_StofHealth_Unit: display-name=%
  base type HS_Sts1CRC_Coding: category=FIXED_LENGTH, base-type-size=8, base-type-encoding=NONE, mem-alignment=0, native-declaration=unsigned char
  unit HS_Sts1CRC_Unit: display-name=count
  base type HS_Sts1Ctr_Coding: category=FIXED_LENGTH, base-type-size=8, base-type-encoding=NONE, mem-alignment=0, native-declaration=unsigned char
  unit HS_Sts1Ctr_Unit: display-name=bit
  base type HS_TotAccumdCh_Coding: category=FIXED_LENGTH, base-type-size=32, base-type-encoding=NONE, mem-alignment=0, native-declaration=unsigned long
  unit HS_TotAccumdCh_Unit: display-name=Ah
  base type HS_TotEThroughput_Coding: category=FIXED_LENGTH, base-type-size=32, base-type-encoding=NONE, mem-alignment=0, native-declaration=unsigned long
  unit HS_TotEThroughput_Unit: display-name=Watt-hour
  base type HS_TotLifetimeEInp_Coding: category=FIXED_LENGTH, base-type-size=32, base-type-encoding=NONE, mem-alignment=0, native-declaration=unsigned long
  unit HS_TotLifetimeEInp_Unit: display-name=kWh
  base type HS_TotLifetimeEOutp_Coding: category=FIXED_LENGTH, base-type-size=32, base-type-encoding=NONE, mem-alignment=0, native-declaration=unsigned long
  unit HS_TotLifetimeEOutp_Unit: display-name=kWh
  base type HS_ULvl_Coding: category=FIXED_LENGTH, base-type-size=16, base-type-encoding=NONE, mem-alignment=0, native-declaration=unsigned short
  unit HS_ULvl_Unit: display-name=V
  base type Hours_Coding: category=FIXED_LENGTH, base-type-size=8, base-type-encoding=NONE, mem-alignment=0, native-declaration=unsigned char
  unit Hours_Unit: display-name=h
  base type HvilPermsnToCls_Coding: category=FIXED_LENGTH, base-type-size=8, base-type-encoding=NONE, mem-alignment=0, native-declaration=unsigned char
  unit HvilPermsnToCls_Unit: display-name=unit
  base type IChLimLong_Coding: category=FIXED_LENGTH, base-type-size=16, base-type-encoding=NONE, mem-alignment=0, native-declaration=unsigned short
  unit IChLimLong_Unit: display-name=A
  base type IDchaLimLong_Coding: category=FIXED_LENGTH, base-type-size=16, base-type-encoding=NONE, mem-alignment=0, native-declaration=unsigned short
  unit IDchaLimLong_Unit: display-name=A
  base type IPermsnToCls_Coding: category=FIXED_LENGTH, base-type-size=8, base-type-encoding=NONE, mem-alignment=0, native-declaration=unsigned char
  base type Inv_SDM_Data_Pg_Rx1_6912_Coding: category=FIXED_LENGTH, base-type-size=8, base-type-encoding=NONE, mem-alignment=0, native-declaration=unsigned char
  base type Inv_SDM_Data_Pg_Rx2_6912_Coding: category=FIXED_LENGTH, base-type-size=8, base-type-encoding=NONE, mem-alignment=0, native-declaration=unsigned char
  base type Inv_SDM_Data_Pg_Rx_61427_Coding: category=FIXED_LENGTH, base-type-size=8, base-type-encoding=NONE, mem-alignment=0, native-declaration=unsigned char
  base type Inv_SDM_Data_Pg_Rx_61483_Coding: category=FIXED_LENGTH, base-type-size=8, base-type-encoding=NONE, mem-alignment=0, native-declaration=unsigned char
  base type Inv_SDM_Data_Pg_Rx_65265_Coding: category=FIXED_LENGTH, base-type-size=8, base-type-encoding=NONE, mem-alignment=0, native-declaration=unsigned char
  base type Inv_SDM_Data_Pg_Rx_65269_Coding: category=FIXED_LENGTH, base-type-size=8, base-type-encoding=NONE, mem-alignment=0, native-declaration=unsigned char
  base type Inv_SDM_Data_Pg_Tx_61423_Coding: category=FIXED_LENGTH, base-type-size=8, base-type-encoding=NONE, mem-alignment=0, native-declaration=unsigned char
  base type Inv_SDM_Data_Pg_Tx_61584_Coding: category=FIXED_LENGTH, base-type-size=8, base-type-encoding=NONE, mem-alignment=0, native-declaration=unsigned char
  base type Inv_SDM_Data_Pg_Tx_61590_Coding: category=FIXED_LENGTH, base-type-size=8, base-type-encoding=NONE, mem-alignment=0, native-declaration=unsigned char
  base type Inv_SDM_Data_Pg_Tx_61708_Coding: category=FIXED_LENGTH, base-type-size=8, base-type-encoding=NONE, mem-alignment=0, native-declaration=unsigned char
  base type Inv_SDM_Data_Pg_Tx_65472_Coding: category=FIXED_LENGTH, base-type-size=8, base-type-encoding=NONE, mem-alignment=0, native-declaration=unsigned char
  base type Inv_SDM_Data_Pg_Tx_65473_Coding: category=FIXED_LENGTH, base-type-size=8, base-type-encoding=NONE, mem-alignment=0, native-declaration=unsigned char
  base type Inv_SDM_Data_Pg_Tx_6912_Coding: category=FIXED_LENGTH, base-type-size=8, base-type-encoding=NONE, mem-alignment=0, native-declaration=unsigned char
  base type Inv_SDM_E_Data_Pg_Rx1_6912_Coding: category=FIXED_LENGTH, base-type-size=8, base-type-encoding=NONE, mem-alignment=0, native-declaration=unsigned char
  base type Inv_SDM_E_Data_Pg_Rx2_6912_Coding: category=FIXED_LENGTH, base-type-size=8, base-type-encoding=NONE, mem-alignment=0, native-declaration=unsigned char
  base type Inv_SDM_E_Data_Pg_Rx_61427_Coding: category=FIXED_LENGTH, base-type-size=8, base-type-encoding=NONE, mem-alignment=0, native-declaration=unsigned char
  base type Inv_SDM_E_Data_Pg_Rx_61483_Coding: category=FIXED_LENGTH, base-type-size=8, base-type-encoding=NONE, mem-alignment=0, native-declaration=unsigned char
  base type Inv_SDM_E_Data_Pg_Rx_65265_Coding: category=FIXED_LENGTH, base-type-size=8, base-type-encoding=NONE, mem-alignment=0, native-declaration=unsigned char
  base type Inv_SDM_E_Data_Pg_Rx_65269_Coding: category=FIXED_LENGTH, base-type-size=8, base-type-encoding=NONE, mem-alignment=0, native-declaration=unsigned char
  base type Inv_SDM_E_Data_Pg_Tx_61584_Coding: category=FIXED_LENGTH, base-type-size=8, base-type-encoding=NONE, mem-alignment=0, native-declaration=unsigned char
  base type Inv_SDM_E_Data_Pg_Tx_61590_Coding: category=FIXED_LENGTH, base-type-size=8, base-type-encoding=NONE, mem-alignment=0, native-declaration=unsigned char
  base type Inv_SDM_E_Data_Pg_Tx_61708_Coding: category=FIXED_LENGTH, base-type-size=8, base-type-encoding=NONE, mem-alignment=0, native-declaration=unsigned char
  base type Inv_SDM_E_Data_Pg_Tx_65472_Coding: category=FIXED_LENGTH, base-type-size=8, base-type-encoding=NONE, mem-alignment=0, native-declaration=unsigned char
  base type Inv_SDM_E_Data_Pg_Tx_65473_Coding: category=FIXED_LENGTH, base-type-size=8, base-type-encoding=NONE, mem-alignment=0, native-declaration=unsigned char
  base type Inv_SDM_Ext_Data_Pg_Tx_61423_Coding: category=FIXED_LENGTH, base-type-size=8, base-type-encoding=NONE, mem-alignment=0, native-declaration=unsigned char
  base type Inv_SDM_Ext_Data_Pg_Tx_6912_Coding: category=FIXED_LENGTH, base-type-size=8, base-type-encoding=NONE, mem-alignment=0, native-declaration=unsigned char
  base type Inv_SDM_PF_Value_Rx1_6912_Coding: category=FIXED_LENGTH, base-type-size=8, base-type-encoding=NONE, mem-alignment=0, native-declaration=unsigned char
  base type Inv_SDM_PF_Value_Rx2_6912_Coding: category=FIXED_LENGTH, base-type-size=8, base-type-encoding=NONE, mem-alignment=0, native-declaration=unsigned char
  base type Inv_SDM_PF_Value_Rx_61427_Coding: category=FIXED_LENGTH, base-type-size=8, base-type-encoding=NONE, mem-alignment=0, native-declaration=unsigned char
  base type Inv_SDM_PF_Value_Rx_61483_Coding: category=FIXED_LENGTH, base-type-size=8, base-type-encoding=NONE, mem-alignment=0, native-declaration=unsigned char
  base type Inv_SDM_PF_Value_Rx_65265_Coding: category=FIXED_LENGTH, base-type-size=8, base-type-encoding=NONE, mem-alignment=0, native-declaration=unsigned char
  base type Inv_SDM_PF_Value_Rx_65269_Coding: category=FIXED_LENGTH, base-type-size=8, base-type-encoding=NONE, mem-alignment=0, native-declaration=unsigned char
  base type Inv_SDM_PF_Value_Tx_61423_Coding: category=FIXED_LENGTH, base-type-size=8, base-type-encoding=NONE, mem-alignment=0, native-declaration=unsigned char
  base type Inv_SDM_PF_Value_Tx_61584_Coding: category=FIXED_LENGTH, base-type-size=8, base-type-encoding=NONE, mem-alignment=0, native-declaration=unsigned char
  base type Inv_SDM_PF_Value_Tx_61590_Coding: category=FIXED_LENGTH, base-type-size=8, base-type-encoding=NONE, mem-alignment=0, native-declaration=unsigned char
  base type Inv_SDM_PF_Value_Tx_61708_Coding: category=FIXED_LENGTH, base-type-size=8, base-type-encoding=NONE, mem-alignment=0, native-declaration=unsigned char
  base type Inv_SDM_PF_Value_Tx_65472_Coding: category=FIXED_LENGTH, base-type-size=8, base-type-encoding=NONE, mem-alignment=0, native-declaration=unsigned char
  base type Inv_SDM_PF_Value_Tx_65473_Coding: category=FIXED_LENGTH, base-type-size=8, base-type-encoding=NONE, mem-alignment=0, native-declaration=unsigned char
  base type Inv_SDM_PF_Value_Tx_6912_Coding: category=FIXED_LENGTH, base-type-size=8, base-type-encoding=NONE, mem-alignment=0, native-declaration=unsigned char
  base type Inv_SDM_PS_Value_Rx1_6912_Coding: category=FIXED_LENGTH, base-type-size=8, base-type-encoding=NONE, mem-alignment=0, native-declaration=unsigned char
  base type Inv_SDM_PS_Value_Rx2_6912_Coding: category=FIXED_LENGTH, base-type-size=8, base-type-encoding=NONE, mem-alignment=0, native-declaration=unsigned char
  base type Inv_SDM_PS_Value_Rx_61427_Coding: category=FIXED_LENGTH, base-type-size=8, base-type-encoding=NONE, mem-alignment=0, native-declaration=unsigned char
  base type Inv_SDM_PS_Value_Rx_61483_Coding: category=FIXED_LENGTH, base-type-size=8, base-type-encoding=NONE, mem-alignment=0, native-declaration=unsigned char
  base type Inv_SDM_PS_Value_Rx_65265_Coding: category=FIXED_LENGTH, base-type-size=8, base-type-encoding=NONE, mem-alignment=0, native-declaration=unsigned char
  base type Inv_SDM_PS_Value_Rx_65269_Coding: category=FIXED_LENGTH, base-type-size=8, base-type-encoding=NONE, mem-alignment=0, native-declaration=unsigned char
  base type Inv_SDM_PS_Value_Tx_61423_Coding: category=FIXED_LENGTH, base-type-size=8, base-type-encoding=NONE, mem-alignment=0, native-declaration=unsigned char
  base type Inv_SDM_PS_Value_Tx_61584_Coding: category=FIXED_LENGTH, base-type-size=8, base-type-encoding=NONE, mem-alignment=0, native-declaration=unsigned char
  base type Inv_SDM_PS_Value_Tx_61590_Coding: category=FIXED_LENGTH, base-type-size=8, base-type-encoding=NONE, mem-alignment=0, native-declaration=unsigned char
  base type Inv_SDM_PS_Value_Tx_61708_Coding: category=FIXED_LENGTH, base-type-size=8, base-type-encoding=NONE, mem-alignment=0, native-declaration=unsigned char
  base type Inv_SDM_PS_Value_Tx_65472_Coding: category=FIXED_LENGTH, base-type-size=8, base-type-encoding=NONE, mem-alignment=0, native-declaration=unsigned char
  base type Inv_SDM_PS_Value_Tx_65473_Coding: category=FIXED_LENGTH, base-type-size=8, base-type-encoding=NONE, mem-alignment=0, native-declaration=unsigned char
  base type Inv_SDM_PS_Value_Tx_6912_Coding: category=FIXED_LENGTH, base-type-size=8, base-type-encoding=NONE, mem-alignment=0, native-declaration=unsigned char
  base type Inv_SDM_SA_Rx1_6912_Coding: category=FIXED_LENGTH, base-type-size=8, base-type-encoding=NONE, mem-alignment=0, native-declaration=unsigned char
  base type Inv_SDM_SA_Rx2_6912_Coding: category=FIXED_LENGTH, base-type-size=8, base-type-encoding=NONE, mem-alignment=0, native-declaration=unsigned char
  base type Inv_SDM_SA_Rx_61427_Coding: category=FIXED_LENGTH, base-type-size=8, base-type-encoding=NONE, mem-alignment=0, native-declaration=unsigned char
  base type Inv_SDM_SA_Rx_61483_Coding: category=FIXED_LENGTH, base-type-size=8, base-type-encoding=NONE, mem-alignment=0, native-declaration=unsigned char
  base type Inv_SDM_SA_Rx_65265_Coding: category=FIXED_LENGTH, base-type-size=8, base-type-encoding=NONE, mem-alignment=0, native-declaration=unsigned char
  base type Inv_SDM_SA_Rx_65269_Coding: category=FIXED_LENGTH, base-type-size=8, base-type-encoding=NONE, mem-alignment=0, native-declaration=unsigned char
  base type Inv_SDM_SA_Tx_61423_Coding: category=FIXED_LENGTH, base-type-size=8, base-type-encoding=NONE, mem-alignment=0, native-declaration=unsigned char
  base type Inv_SDM_SA_Tx_61584_Coding: category=FIXED_LENGTH, base-type-size=8, base-type-encoding=NONE, mem-alignment=0, native-declaration=unsigned char
  base type Inv_SDM_SA_Tx_61590_Coding: category=FIXED_LENGTH, base-type-size=8, base-type-encoding=NONE, mem-alignment=0, native-declaration=unsigned char
  base type Inv_SDM_SA_Tx_61708_Coding: category=FIXED_LENGTH, base-type-size=8, base-type-encoding=NONE, mem-alignment=0, native-declaration=unsigned char
  base type Inv_SDM_SA_Tx_65472_Coding: category=FIXED_LENGTH, base-type-size=8, base-type-encoding=NONE, mem-alignment=0, native-declaration=unsigned char
  base type Inv_SDM_SA_Tx_65473_Coding: category=FIXED_LENGTH, base-type-size=8, base-type-encoding=NONE, mem-alignment=0, native-declaration=unsigned char
  base type Inv_SDM_SA_Tx_6912_Coding: category=FIXED_LENGTH, base-type-size=8, base-type-encoding=NONE, mem-alignment=0, native-declaration=unsigned char
  base type IslnPermsnToCls_Coding: category=FIXED_LENGTH, base-type-size=8, base-type-encoding=NONE, mem-alignment=0, native-declaration=unsigned char
  base type Lcl_houroffset_Coding: category=FIXED_LENGTH, base-type-size=8, base-type-encoding=NONE, mem-alignment=0, native-declaration=unsigned char
  unit Lcl_houroffset_Unit: display-name=h
  base type Lcl_minuteoffset_Coding: category=FIXED_LENGTH, base-type-size=8, base-type-encoding=NONE, mem-alignment=0, native-declaration=unsigned char
  unit Lcl_minuteoffset_Unit: display-name=min
  base type LockMemPermsnToCls_Coding: category=FIXED_LENGTH, base-type-size=8, base-type-encoding=NONE, mem-alignment=0, native-declaration=unsigned char
  base type Mil_Coding: category=FIXED_LENGTH, base-type-size=8, base-type-encoding=NONE, mem-alignment=0, native-declaration=unsigned char
  base type Minutes_Coding: category=FIXED_LENGTH, base-type-size=8, base-type-encoding=NONE, mem-alignment=0, native-declaration=unsigned char
  unit Minutes_Unit: display-name=min
  base type Month_Coding: category=FIXED_LENGTH, base-type-size=8, base-type-encoding=NONE, mem-alignment=0, native-declaration=unsigned char
  unit Month_Unit: display-name=months
  base type Oc01_Coding: category=FIXED_LENGTH, base-type-size=8, base-type-encoding=NONE, mem-alignment=0, native-declaration=unsigned char
  unit Oc01_Unit: display-name=binary
  base type Oc02_Coding: category=FIXED_LENGTH, base-type-size=8, base-type-encoding=NONE, mem-alignment=0, native-declaration=unsigned char
  unit Oc02_Unit: display-name=binary
  base type Oc03_Coding: category=FIXED_LENGTH, base-type-size=8, base-type-encoding=NONE, mem-alignment=0, native-declaration=unsigned char
  unit Oc03_Unit: display-name=binary
  base type Oc04_Coding: category=FIXED_LENGTH, base-type-size=8, base-type-encoding=NONE, mem-alignment=0, native-declaration=unsigned char
  unit Oc04_Unit: display-name=binary
  base type Oc05_Coding: category=FIXED_LENGTH, base-type-size=8, base-type-encoding=NONE, mem-alignment=0, native-declaration=unsigned char
  unit Oc05_Unit: display-name=binary
  base type Oc06_Coding: category=FIXED_LENGTH, base-type-size=8, base-type-encoding=NONE, mem-alignment=0, native-declaration=unsigned char
  unit Oc06_Unit: display-name=binary
  base type Oc07_Coding: category=FIXED_LENGTH, base-type-size=8, base-type-encoding=NONE, mem-alignment=0, native-declaration=unsigned char
  unit Oc07_Unit: display-name=binary
  base type Oc08_Coding: category=FIXED_LENGTH, base-type-size=8, base-type-encoding=NONE, mem-alignment=0, native-declaration=unsigned char
  unit Oc08_Unit: display-name=binary
  base type Oc09_Coding: category=FIXED_LENGTH, base-type-size=8, base-type-encoding=NONE, mem-alignment=0, native-declaration=unsigned char
  unit Oc09_Unit: display-name=binary
  base type Oc10_Coding: category=FIXED_LENGTH, base-type-size=8, base-type-encoding=NONE, mem-alignment=0, native-declaration=unsigned char
  unit Oc10_Unit: display-name=binary
  base type PGN_Packet_Message_BAM_Coding: category=FIXED_LENGTH, base-type-size=32, base-type-encoding=NONE, mem-alignment=0, native-declaration=unsigned long
  unit PGN_Packet_Message_BAM_Unit: display-name=bit
  base type PS_Lock_Activated_Coding: category=FIXED_LENGTH, base-type-size=8, base-type-encoding=NONE, mem-alignment=0, native-declaration=unsigned char
  unit PS_Lock_Activated_Unit: display-name=bit
  base type PTO_Governor_State_Coding: category=FIXED_LENGTH, base-type-size=8, base-type-encoding=NONE, mem-alignment=0, native-declaration=unsigned char
  unit PTO_Governor_State_Unit: display-name=bit
  base type P_Actual_Coding: category=FIXED_LENGTH, base-type-size=16, base-type-encoding=NONE, mem-alignment=0, native-declaration=unsigned short
  unit P_Actual_Unit: display-name=W
  base type P_Coding: category=FIXED_LENGTH, base-type-size=16, base-type-encoding=NONE, mem-alignment=0, native-declaration=unsigned short
  unit P_Unit: display-name=kW
  base type PackNameThermReq1_Coding: category=FIXED_LENGTH, base-type-size=8, base-type-encoding=NONE, mem-alignment=0, native-declaration=unsigned char
  base type Packetized_Data{2..7}_TP_DT_Coding: category=FIXED_LENGTH, base-type-size=8, base-type-encoding=NONE, mem-alignment=0, native-declaration=unsigned char
  base type Park_Brake_Rel_Inhibit_Req_Coding: category=FIXED_LENGTH, base-type-size=8, base-type-encoding=NONE, mem-alignment=0, native-declaration=unsigned char
  unit Park_Brake_Rel_Inhibit_Req_Unit: display-name=bit
  base type Parking_Brake_Swtch_Coding: category=FIXED_LENGTH, base-type-size=8, base-type-encoding=NONE, mem-alignment=0, native-declaration=unsigned char
  unit Parking_Brake_Swtch_Unit: display-name=bit
  base type ProtLamp_Coding: category=FIXED_LENGTH, base-type-size=8, base-type-encoding=NONE, mem-alignment=0, native-declaration=unsigned char
  base type RQST_Rx1_Coding: category=FIXED_LENGTH, base-type-size=32, base-type-encoding=NONE, mem-alignment=0, native-declaration=unsigned long
  base type RQST_Rx2_Coding: category=FIXED_LENGTH, base-type-size=32, base-type-encoding=NONE, mem-alignment=0, native-declaration=unsigned long
  base type RQST_Tx_Coding: category=FIXED_LENGTH, base-type-size=32, base-type-encoding=NONE, mem-alignment=0, native-declaration=unsigned long
  unit RQST_Tx_Unit: display-name=unit
  base type Reserved_1_PGN61427_Coding: category=FIXED_LENGTH, base-type-size=8, base-type-encoding=NONE, mem-alignment=0, native-declaration=unsigned char
  unit Reserved_1_PGN61427_Unit: display-name=unit
  base type Reserved_2_PGN61427_Coding: category=FIXED_LENGTH, base-type-size=32, base-type-encoding=NONE, mem-alignment=0, native-declaration=unsigned long
  unit Reserved_2_PGN61427_Unit: display-name=unit
  base type Reserved_PGN65476_Coding: category=FIXED_LENGTH, base-type-size=8, base-type-encoding=NONE, mem-alignment=0, native-declaration=unsigned char
  unit Reserved_PGN65476_Unit: display-name=bit
  base type Road_SurfT_Coding: category=FIXED_LENGTH, base-type-size=16, base-type-encoding=NONE, mem-alignment=0, native-declaration=unsigned short
  unit Road_SurfT_Unit: display-name=°C
  base type Rsl_Coding: category=FIXED_LENGTH, base-type-size=8, base-type-encoding=NONE, mem-alignment=0, native-declaration=unsigned char
  base type SDM_Data_CRC_Rx1_6912_Coding: category=FIXED_LENGTH, base-type-size=32, base-type-encoding=NONE, mem-alignment=0, native-declaration=unsigned long
  base type SDM_Data_CRC_Rx2_6912_Coding: category=FIXED_LENGTH, base-type-size=32, base-type-encoding=NONE, mem-alignment=0, native-declaration=unsigned long
  base type SDM_Data_CRC_Rx_61427_Coding: category=FIXED_LENGTH, base-type-size=32, base-type-encoding=NONE, mem-alignment=0, native-declaration=unsigned long
  base type SDM_Data_CRC_Rx_61483_Coding: category=FIXED_LENGTH, base-type-size=32, base-type-encoding=NONE, mem-alignment=0, native-declaration=unsigned long
  base type SDM_Data_CRC_Rx_65265_Coding: category=FIXED_LENGTH, base-type-size=32, base-type-encoding=NONE, mem-alignment=0, native-declaration=unsigned long
  base type SDM_Data_CRC_Rx_65269_Coding: category=FIXED_LENGTH, base-type-size=32, base-type-encoding=NONE, mem-alignment=0, native-declaration=unsigned long
  base type SDM_Data_CRC_Tx_61423_Coding: category=FIXED_LENGTH, base-type-size=32, base-type-encoding=NONE, mem-alignment=0, native-declaration=unsigned long
  base type SDM_Data_CRC_Tx_61584_Coding: category=FIXED_LENGTH, base-type-size=32, base-type-encoding=NONE, mem-alignment=0, native-declaration=unsigned long
  base type SDM_Data_CRC_Tx_61590_Coding: category=FIXED_LENGTH, base-type-size=32, base-type-encoding=NONE, mem-alignment=0, native-declaration=unsigned long
  base type SDM_Data_CRC_Tx_61708_Coding: category=FIXED_LENGTH, base-type-size=32, base-type-encoding=NONE, mem-alignment=0, native-declaration=unsigned long
  base type SDM_Data_CRC_Tx_65472_Coding: category=FIXED_LENGTH, base-type-size=32, base-type-encoding=NONE, mem-alignment=0, native-declaration=unsigned long
  base type SDM_Data_CRC_Tx_65473_Coding: category=FIXED_LENGTH, base-type-size=32, base-type-encoding=NONE, mem-alignment=0, native-declaration=unsigned long
  base type SDM_Data_CRC_Tx_6912_Coding: category=FIXED_LENGTH, base-type-size=32, base-type-encoding=NONE, mem-alignment=0, native-declaration=unsigned long
  base type SHM_Reserved_Rx1_6912_Coding: category=FIXED_LENGTH, base-type-size=8, base-type-encoding=NONE, mem-alignment=0, native-declaration=unsigned char
  base type SHM_Reserved_Rx2_6912_Coding: category=FIXED_LENGTH, base-type-size=8, base-type-encoding=NONE, mem-alignment=0, native-declaration=unsigned char
  base type SHM_Reserved_Rx_61427_Coding: category=FIXED_LENGTH, base-type-size=8, base-type-encoding=NONE, mem-alignment=0, native-declaration=unsigned char
  base type SHM_Reserved_Rx_61483_Coding: category=FIXED_LENGTH, base-type-size=8, base-type-encoding=NONE, mem-alignment=0, native-declaration=unsigned char
  base type SHM_Reserved_Rx_65265_Coding: category=FIXED_LENGTH, base-type-size=8, base-type-encoding=NONE, mem-alignment=0, native-declaration=unsigned char
  base type SHM_Reserved_Rx_65269_Coding: category=FIXED_LENGTH, base-type-size=8, base-type-encoding=NONE, mem-alignment=0, native-declaration=unsigned char
  base type SHM_Reserved_Tx_61423_Coding: category=FIXED_LENGTH, base-type-size=8, base-type-encoding=NONE, mem-alignment=0, native-declaration=unsigned char
  base type SHM_Reserved_Tx_61584_Coding: category=FIXED_LENGTH, base-type-size=8, base-type-encoding=NONE, mem-alignment=0, native-declaration=unsigned char
  base type SHM_Reserved_Tx_61590_Coding: category=FIXED_LENGTH, base-type-size=8, base-type-encoding=NONE, mem-alignment=0, native-declaration=unsigned char
  base type SHM_Reserved_Tx_61708_Coding: category=FIXED_LENGTH, base-type-size=8, base-type-encoding=NONE, mem-alignment=0, native-declaration=unsigned char
  base type SHM_Reserved_Tx_65472_Coding: category=FIXED_LENGTH, base-type-size=8, base-type-encoding=NONE, mem-alignment=0, native-declaration=unsigned char
  base type SHM_Reserved_Tx_65473_Coding: category=FIXED_LENGTH, base-type-size=8, base-type-encoding=NONE, mem-alignment=0, native-declaration=unsigned char
  base type SHM_Reserved_Tx_6912_Coding: category=FIXED_LENGTH, base-type-size=8, base-type-encoding=NONE, mem-alignment=0, native-declaration=unsigned char
  base type Seconds_Coding: category=FIXED_LENGTH, base-type-size=8, base-type-encoding=NONE, mem-alignment=0, native-declaration=unsigned char
  unit Seconds_Unit: display-name=s
  base type Sequence_Number_Rx1_6912_Coding: category=FIXED_LENGTH, base-type-size=8, base-type-encoding=NONE, mem-alignment=0, native-declaration=unsigned char
  base type Sequence_Number_Rx2_6912_Coding: category=FIXED_LENGTH, base-type-size=8, base-type-encoding=NONE, mem-alignment=0, native-declaration=unsigned char
  base type Sequence_Number_Rx_61427_Coding: category=FIXED_LENGTH, base-type-size=8, base-type-encoding=NONE, mem-alignment=0, native-declaration=unsigned char
  base type Sequence_Number_Rx_61483_Coding: category=FIXED_LENGTH, base-type-size=8, base-type-encoding=NONE, mem-alignment=0, native-declaration=unsigned char
  base type Sequence_Number_Rx_65265_Coding: category=FIXED_LENGTH, base-type-size=8, base-type-encoding=NONE, mem-alignment=0, native-declaration=unsigned char
  base type Sequence_Number_Rx_65269_Coding: category=FIXED_LENGTH, base-type-size=8, base-type-encoding=NONE, mem-alignment=0, native-declaration=unsigned char
  base type Sequence_Number_TP_DT_Coding: category=FIXED_LENGTH, base-type-size=8, base-type-encoding=NONE, mem-alignment=0, native-declaration=unsigned char
  unit Sequence_Number_TP_DT_Unit: display-name=count
  base type Sequence_Number_Tx_61423_Coding: category=FIXED_LENGTH, base-type-size=8, base-type-encoding=NONE, mem-alignment=0, native-declaration=unsigned char
  base type Sequence_Number_Tx_61584_Coding: category=FIXED_LENGTH, base-type-size=8, base-type-encoding=NONE, mem-alignment=0, native-declaration=unsigned char
  base type Sequence_Number_Tx_61590_Coding: category=FIXED_LENGTH, base-type-size=8, base-type-encoding=NONE, mem-alignment=0, native-declaration=unsigned char
  base type Sequence_Number_Tx_61708_Coding: category=FIXED_LENGTH, base-type-size=8, base-type-encoding=NONE, mem-alignment=0, native-declaration=unsigned char
  base type Sequence_Number_Tx_65472_Coding: category=FIXED_LENGTH, base-type-size=8, base-type-encoding=NONE, mem-alignment=0, native-declaration=unsigned char
  base type Sequence_Number_Tx_65473_Coding: category=FIXED_LENGTH, base-type-size=8, base-type-encoding=NONE, mem-alignment=0, native-declaration=unsigned char
  base type Sequence_Number_Tx_6912_Coding: category=FIXED_LENGTH, base-type-size=8, base-type-encoding=NONE, mem-alignment=0, native-declaration=unsigned char
  base type Service_Mode_Request_Coding: category=FIXED_LENGTH, base-type-size=8, base-type-encoding=NONE, mem-alignment=0, native-declaration=unsigned char
  unit Service_Mode_Request_Unit: display-name=bit
  base type ShutDown_Clearance_Coding: category=FIXED_LENGTH, base-type-size=8, base-type-encoding=NONE, mem-alignment=0, native-declaration=unsigned char
  unit ShutDown_Clearance_Unit: display-name=bit
  base type Spn01_Coding: category=FIXED_LENGTH, base-type-size=16, base-type-encoding=NONE, mem-alignment=0, native-declaration=unsigned short
  unit Spn01_Unit: display-name=binary
  base type Spn02_Coding: category=FIXED_LENGTH, base-type-size=16, base-type-encoding=NONE, mem-alignment=0, native-declaration=unsigned short
  unit Spn02_Unit: display-name=binary
  base type Spn03_Coding: category=FIXED_LENGTH, base-type-size=16, base-type-encoding=NONE, mem-alignment=0, native-declaration=unsigned short
  unit Spn03_Unit: display-name=binary
  base type Spn04_Coding: category=FIXED_LENGTH, base-type-size=16, base-type-encoding=NONE, mem-alignment=0, native-declaration=unsigned short
  unit Spn04_Unit: display-name=binary
  base type Spn05_Coding: category=FIXED_LENGTH, base-type-size=16, base-type-encoding=NONE, mem-alignment=0, native-declaration=unsigned short
  unit Spn05_Unit: display-name=binary
  base type Spn06_Coding: category=FIXED_LENGTH, base-type-size=16, base-type-encoding=NONE, mem-alignment=0, native-declaration=unsigned short
  unit Spn06_Unit: display-name=binary
  base type Spn07_Coding: category=FIXED_LENGTH, base-type-size=16, base-type-encoding=NONE, mem-alignment=0, native-declaration=unsigned short
  unit Spn07_Unit: display-name=binary
  base type Spn08_Coding: category=FIXED_LENGTH, base-type-size=16, base-type-encoding=NONE, mem-alignment=0, native-declaration=unsigned short
  unit Spn08_Unit: display-name=binary
  base type Spn09_Coding: category=FIXED_LENGTH, base-type-size=16, base-type-encoding=NONE, mem-alignment=0, native-declaration=unsigned short
  unit Spn09_Unit: display-name=binary
  base type Spn10_Coding: category=FIXED_LENGTH, base-type-size=16, base-type-encoding=NONE, mem-alignment=0, native-declaration=unsigned short
  unit Spn10_Unit: display-name=binary
  base type SpnCm{01..10}_Coding: category=FIXED_LENGTH, base-type-size=8, base-type-encoding=NONE, mem-alignment=0, native-declaration=unsigned char
  base type SpnHigh01_Coding: category=FIXED_LENGTH, base-type-size=8, base-type-encoding=NONE, mem-alignment=0, native-declaration=unsigned char
  unit SpnHigh01_Unit: display-name=binary
  base type SpnHigh02_Coding: category=FIXED_LENGTH, base-type-size=8, base-type-encoding=NONE, mem-alignment=0, native-declaration=unsigned char
  unit SpnHigh02_Unit: display-name=binary
  base type SpnHigh03_Coding: category=FIXED_LENGTH, base-type-size=8, base-type-encoding=NONE, mem-alignment=0, native-declaration=unsigned char
  unit SpnHigh03_Unit: display-name=binary
  base type SpnHigh04_Coding: category=FIXED_LENGTH, base-type-size=8, base-type-encoding=NONE, mem-alignment=0, native-declaration=unsigned char
  unit SpnHigh04_Unit: display-name=binary
  base type SpnHigh05_Coding: category=FIXED_LENGTH, base-type-size=8, base-type-encoding=NONE, mem-alignment=0, native-declaration=unsigned char
  unit SpnHigh05_Unit: display-name=binary
  base type SpnHigh06_Coding: category=FIXED_LENGTH, base-type-size=8, base-type-encoding=NONE, mem-alignment=0, native-declaration=unsigned char
  unit SpnHigh06_Unit: display-name=binary
  base type SpnHigh07_Coding: category=FIXED_LENGTH, base-type-size=8, base-type-encoding=NONE, mem-alignment=0, native-declaration=unsigned char
  unit SpnHigh07_Unit: display-name=binary
  base type SpnHigh08_Coding: category=FIXED_LENGTH, base-type-size=8, base-type-encoding=NONE, mem-alignment=0, native-declaration=unsigned char
  unit SpnHigh08_Unit: display-name=binary
  base type SpnHigh09_Coding: category=FIXED_LENGTH, base-type-size=8, base-type-encoding=NONE, mem-alignment=0, native-declaration=unsigned char
  unit SpnHigh09_Unit: display-name=binary
  base type SpnHigh10_Coding: category=FIXED_LENGTH, base-type-size=8, base-type-encoding=NONE, mem-alignment=0, native-declaration=unsigned char
  unit SpnHigh10_Unit: display-name=binary
  base type State_Device_Coding: category=FIXED_LENGTH, base-type-size=8, base-type-encoding=NONE, mem-alignment=0, native-declaration=unsigned char
  base type State_Es_Relay_Coding: category=FIXED_LENGTH, base-type-size=8, base-type-encoding=NONE, mem-alignment=0, native-declaration=unsigned char
  unit State_Es_Relay_Unit: display-name=bit
  base type State_Of_Reduction_Coding: category=FIXED_LENGTH, base-type-size=8, base-type-encoding=NONE, mem-alignment=0, native-declaration=unsigned char
  base type TAct_Coding: category=FIXED_LENGTH, base-type-size=16, base-type-encoding=NONE, mem-alignment=0, native-declaration=unsigned short
  unit TAct_Unit: display-name=°C
  base type TSetPoint_Coding: category=FIXED_LENGTH, base-type-size=16, base-type-encoding=NONE, mem-alignment=0, native-declaration=unsigned short
  unit TSetPoint_Unit: display-name=°C
  base type Terminal_Voltage_Actual_Coding: category=FIXED_LENGTH, base-type-size=16, base-type-encoding=NONE, mem-alignment=0, native-declaration=unsigned short
  unit Terminal_Voltage_Actual_Unit: display-name=V
  base type ThermEveStsCellT_Coding: category=FIXED_LENGTH, base-type-size=8, base-type-encoding=NONE, mem-alignment=0, native-declaration=unsigned char
  unit ThermEveStsCellT_Unit: display-name=unit
  base type ThermMngtSysCmpr_Coding: category=FIXED_LENGTH, base-type-size=8, base-type-encoding=NONE, mem-alignment=0, native-declaration=unsigned char
  unit ThermMngtSysCmpr_Unit: display-name=rpm
  base type ThermMngtSysCooltLvl_Coding: category=FIXED_LENGTH, base-type-size=8, base-type-encoding=NONE, mem-alignment=0, native-declaration=unsigned char
  base type ThermMngtSysHVILSts_Coding: category=FIXED_LENGTH, base-type-size=8, base-type-encoding=NONE, mem-alignment=0, native-declaration=unsigned char
  base type ThermMngtSysHeatrSts_Coding: category=FIXED_LENGTH, base-type-size=8, base-type-encoding=NONE, mem-alignment=0, native-declaration=unsigned char
  base type ThermMngtSysHv_Coding: category=FIXED_LENGTH, base-type-size=16, base-type-encoding=NONE, mem-alignment=0, native-declaration=unsigned short
  unit ThermMngtSysHv_Unit: display-name=W
  base type ThermMngtSysMode_Coding: category=FIXED_LENGTH, base-type-size=8, base-type-encoding=NONE, mem-alignment=0, native-declaration=unsigned char
  base type ThermMngtSysRel_Coding: category=FIXED_LENGTH, base-type-size=8, base-type-encoding=NONE, mem-alignment=0, native-declaration=unsigned char
  unit ThermMngtSysRel_Unit: display-name=%
  base type ThermMngtSysSLIInpPwr_Coding: category=FIXED_LENGTH, base-type-size=16, base-type-encoding=NONE, mem-alignment=0, native-declaration=unsigned short
  unit ThermMngtSysSLIInpPwr_Unit: display-name=W
  base type ThermRunAwPermsnToCls_Coding: category=FIXED_LENGTH, base-type-size=8, base-type-encoding=NONE, mem-alignment=0, native-declaration=unsigned char
  base type ThermSysStrtReq1_Coding: category=FIXED_LENGTH, base-type-size=8, base-type-encoding=NONE, mem-alignment=0, native-declaration=unsigned char
  base type Total_Message_Size_BAM_Coding: category=FIXED_LENGTH, base-type-size=16, base-type-encoding=NONE, mem-alignment=0, native-declaration=unsigned short
  unit Total_Message_Size_BAM_Unit: display-name=count
  base type Total_Num_Of_Packet_BAM_Coding: category=FIXED_LENGTH, base-type-size=8, base-type-encoding=NONE, mem-alignment=0, native-declaration=unsigned char
  unit Total_Num_Of_Packet_BAM_Unit: display-name=count
  base type Two_Spd_Axle_Switch_Coding: category=FIXED_LENGTH, base-type-size=8, base-type-encoding=NONE, mem-alignment=0, native-declaration=unsigned char
  unit Two_Spd_Axle_Switch_Unit: display-name=bit
  base type UChLimLong_Coding: category=FIXED_LENGTH, base-type-size=16, base-type-encoding=NONE, mem-alignment=0, native-declaration=unsigned short
  unit UChLimLong_Unit: display-name=V
  base type UDcLnk_Coding: category=FIXED_LENGTH, base-type-size=16, base-type-encoding=NONE, mem-alignment=0, native-declaration=unsigned short
  unit UDcLnk_Unit: display-name=V
  base type UDchaLimLong_Coding: category=FIXED_LENGTH, base-type-size=16, base-type-encoding=NONE, mem-alignment=0, native-declaration=unsigned short
  unit UDchaLimLong_Unit: display-name=V
  base type UDchaLimSho_Coding: category=FIXED_LENGTH, base-type-size=16, base-type-encoding=NONE, mem-alignment=0, native-declaration=unsigned short
  unit UDchaLimSho_Unit: display-name=V
  base type Wheel_Based_Veh_Spd_Coding: category=FIXED_LENGTH, base-type-size=16, base-type-encoding=NONE, mem-alignment=0, native-declaration=unsigned short
  unit Wheel_Based_Veh_Spd_Unit: display-name=km/h
  base type Year_Coding: category=FIXED_LENGTH, base-type-size=8, base-type-encoding=NONE, mem-alignment=0, native-declaration=unsigned char
  unit Year_Unit: display-name=years
package /Vehicle_CAN_Bus_J1939/ECUs
  4 x ecu instance:
    DMU_VEDS  # Voith ECU
      can communication controller DMU_VEDS_CANController
      can communication connector DMU_VEDS_CANConnector: comm-controller=DMU_VEDS_CANController
    Thermal_Management_System_ECU  # Webasto eBTM 2.0 Battery Thermal Management System (BTMS)
      can communication controller Thermal_Management_System_ECU_CANController
      can communication connector Thermal_Management_System_ECU_CANConnector: comm-controller=Thermal_Management_System_ECU_CANController
    VIC  # Battery Management System
      can communication controller VIC_CANController
      can communication connector VIC_CANConnector: comm-controller=VIC_CANController
    Vehicle_Control_Unit  # Vehicle ECU
      can communication controller Vehicle_Control_Unit_CANController
      can communication connector Vehicle_Control_Unit_CANConnector: comm-controller=Vehicle_Control_Unit_CANController
